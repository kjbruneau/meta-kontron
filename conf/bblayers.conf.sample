## conf/bblayers.conf.sample
```bitbake
BBPATH = "${TOPDIR}"
BBFILES ?= ""

BBLAYERS ?= " \
  ##OEROOR##/poky-honister-26.0.0/meta \
  ##OEROOR##/poky-honister-26.0.0/meta-poky \
  ##OEROOR##/poky-honister-26.0.0/meta-yocto-bsp \
  ##OEROOR##/meta-openembedded/meta-filesystems \
  ##OEROOR##/meta-openembedded/meta-gnome \
  ##OEROOR##/meta-openembedded/meta-multimedia \
  ##OEROOR##/meta-openembedded/meta-networking \
  ##OEROOR##/meta-openembedded/meta-oe \
  ##OEROOR##/meta-openembedded/meta-perl \
  ##OEROOR##/meta-openembedded/meta-python \
  ##OEROOR##/meta-openembedded/meta-xfce \
  ##OEROOR##/meta-security \
  ##OEROOR##/meta-security/meta-tpm \
  ##OEROOR##/meta-intel \
  ##OEROOR##/meta-clang \
  ##OEROOR##/meta-kontron \
  ##OEROOR##/meta-kontron-##BSP## \
  "
```

## conf/layer.conf
```bitbake
# We have a conf and classes directory, add to BBPATH
BBPATH .= ":${LAYERDIR}"

# We have a recipes directory, add to BBFILES
BBFILES += "${LAYERDIR}/recipes-*/*/*.bb \
            ${LAYERDIR}/recipes-*/*/*.bbappend"

BBFILE_COLLECTIONS += "kontron"
BBFILE_PATTERN_kontron := "^${LAYERDIR}/"
BBFILE_PRIORITY_kontron = "8"

# Additional license directories.
LICENSE_PATH += "${LAYERDIR}/custom-licenses"

LAYERSERIES_COMPAT_kontron = "honister"

# Needed for xfce related things.
DISTRO_FEATURES:append = " polkit upower"

# One is in meta-tpm another in meta-oe.
# meta-oe is choosen
PREFERRED_RPROVIDER_cryptsetup = "cryptsetup"
PREFERRED_RPROVIDER_cryptsetup-dev = "cryptsetup"
```
